## drivers/rknpu/Kconfig
```kconfig
# SPDX-License-Identifier: GPL-2.0
menu "RKNPU"
	depends on ARCH_ROCKCHIP

config ROCKCHIP_RKNPU
	tristate "ROCKCHIP_RKNPU"
	depends on DRM
	help
	  rknpu module.

if ROCKCHIP_RKNPU

config ROCKCHIP_RKNPU_DEBUG_FS
	bool "RKNPU debugfs"
	depends on DEBUG_FS
	default y
	help
	  Enable debugfs to debug RKNPU usage.

config ROCKCHIP_RKNPU_PROC_FS
	bool "RKNPU procfs"
	depends on PROC_FS
	help
	  Enable procfs to debug RKNPU usage.

config ROCKCHIP_RKNPU_FENCE
	bool "RKNPU fence"
	depends on SYNC_FILE
	help
	  Enable fence support for RKNPU.

config ROCKCHIP_RKNPU_DRM_GEM
	bool
	default y
	depends on DRM
	help
	  RKNPU memory manager by DRM GEM.

endif

endmenu
```
